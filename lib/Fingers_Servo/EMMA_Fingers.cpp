/* ════════════════════════════════════════════════════════════════
 *  EMMA Fingers
 *  ----------------------------------------------------------------
 *  Логика управления кареткой с 4 пальцами скрипача.
 *
 *  Хранит абсолютные координаты пальцев в шагах мотора,
 *  по номеру ноты вычисляет нужную дельту и запускает каретку.
 *  Подъём и нажатие пальцев — забота вызывающего кода.
 * ════════════════════════════════════════════════════════════════ */

#include "EMMA_Fingers.h"
#include "EMMA_Stepper_Motor.h"

extern void activate_finger(int index);

/* ─── Состояние пальцев ───────────────────────────────────────── */

static long _finger_pos[4] = {0, 0, 0, 0};   // Абсолютные координаты 4 пальцев (шаги)
static int  _notes_count   = 0;              // Количество нот в раскладке

/* ─── Состояние движения ──────────────────────────────────────── */

static bool _moving        = false;          // Каретка в движении
static long _pending_delta = 0;              // Дельта текущего перемещения (шаги)
static int  _active_finger = -1;             // Палец, обслуживающий текущую ноту


/* ════════════════════════════════════════════════════════════════
 *  get_finger_for_note
 *  ----------------------------------------------------------------
 *  Возвращает индекс пальца (0..3), обслуживающего заданную ноту.
 * ════════════════════════════════════════════════════════════════ */

int get_finger_for_note(int nota) {
    switch (nota) {
        case 1: return 0;   // Note 1 (18mm)  -> Index
        case 2: return 0;   // Note 2 (35mm)  -> Index
        case 3: return 1;   // Note 3 (52mm)  -> Middle
        case 4: return 1;   // Note 4 (66mm)  -> Middle
        case 5: return 2;   // Note 5 (80mm)  -> Ring
        case 6: return 3;   // Note 6 (94mm)  -> Pinky
        case 7: return 3;   // Note 7 (110mm) -> Pinky
        default: return 0;  // Защита от мусора
    }
}


/* ════════════════════════════════════════════════════════════════
 *  fingers_init
 *  ----------------------------------------------------------------
 *  Переводит координаты нот из миллиметров в шаги мотора.
 *  Вызывается один раз при старте.
 * ════════════════════════════════════════════════════════════════ */

void fingers_init(long* notes, int notes_count, int pulses_per_mm) {
    _notes_count = notes_count;
    for (int i = 0; i < notes_count; i++) {
        notes[i] *= pulses_per_mm;
    }
}


/* ════════════════════════════════════════════════════════════════
 *  fingers_set_home
 *  ----------------------------------------------------------------
 *  Фиксирует физические домашние позиции пальцев после калибровки.
 * ════════════════════════════════════════════════════════════════ */


 void fingers_set_home(long* phys_pos) {
    // Просто записываем 4 физические координаты пальцев
    _finger_pos[0] = phys_pos[0];
    _finger_pos[1] = phys_pos[1];
    _finger_pos[2] = phys_pos[2];
    _finger_pos[3] = phys_pos[3];
}
/*
void fingers_set_home(long* notes) {
    
   // magor
   // _finger_pos[0] = notes[1];
   // _finger_pos[1] = notes[3];
   // _finger_pos[2] = notes[4];
   // _finger_pos[3] = notes[6];


    
    // minor 
   
    _finger_pos[0] = notes[1];
    _finger_pos[1] = notes[3];
    _finger_pos[2] = notes[4];
    _finger_pos[3] = notes[6];

    
}
*/

/* ════════════════════════════════════════════════════════════════
 *  set_note
 *  ----------------------------------------------------------------
 *  Считает дельту до заданной ноты и запускает каретку.
 *  Подъём и нажатие пальца — забота вызывающего кода.
 * ════════════════════════════════════════════════════════════════ */

void set_note(int nota, long* notes) {
    if (nota < 1 || nota > _notes_count) {
        Serial.println("[FINGERS] ERROR: Invalid note!");
        return;
    }

    _active_finger = get_finger_for_note(nota);
    long target_pos = notes[nota - 1];
    _pending_delta  = target_pos - _finger_pos[_active_finger];

    if (_pending_delta != 0) {
        bool dir = (_pending_delta < 0);
        //stepper_move(abs(_pending_delta), dir, 25000, 2500, 300, 300);
        
        
        //stepper_move(abs(_pending_delta), dir, 14000, 1900, 200, 70);
        stepper_move(abs(_pending_delta), dir, 12000, 1900, 200, 150);

        _moving = true; 
    } else {
        _moving = false;
    }
}


/* ════════════════════════════════════════════════════════════════
 *  fingers_update
 *  ----------------------------------------------------------------
 *  Отслеживает завершение движения каретки и синхронно сдвигает
 *  координаты всех пальцев на пройденную дельту.
 * ════════════════════════════════════════════════════════════════ */

void fingers_update() {
    if (_moving) {
        if (stepper_is_ready()) {
            // Каретка одна — сдвигаем координаты всех пальцев
            for (int i = 0; i < 4; i++) {
                _finger_pos[i] += _pending_delta;
            }
            _moving = false;
        }
    }
}


/* ════════════════════════════════════════════════════════════════
 *  fingers_are_busy
 *  ----------------------------------------------------------------
 *  Возвращает true, если каретка в движении.
 * ════════════════════════════════════════════════════════════════ */

bool fingers_are_busy() {
    return _moving;
}


/* ════════════════════════════════════════════════════════════════
 *  get_active_finger
 *  ----------------------------------------------------------------
 *  Возвращает индекс пальца текущей ноты.
 * ════════════════════════════════════════════════════════════════ */

int get_active_finger() {
    return _active_finger;
}
